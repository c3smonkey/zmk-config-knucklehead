/*
 * Copyright (c) 2020 The ZMK Contributors
 *
 * SPDX-License-Identifier: MIT
 */

#include "../knucklehead/base.dtsi"
#include "../c3s/base.dtsi"
#include "../c3s/L0_Base_keyemap.dtsi"
#include "../c3s/L1_Number_Navigation.dtsi"
#include "../c3s/L2_Function.dtsi"



